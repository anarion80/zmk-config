#define VERSION_MACRO
macro_ver: macro_ver {
compatible = "zmk,behavior-macro";
#binding-cells = <0>;
bindings = <&kp N2>, <&kp N0>, <&kp N2>, <&kp N5>, <&kp N0>, <&kp N4>, <&kp N1>, <&kp N5>, <&kp MINUS>, <&kp M>, <&kp A>, <&kp I>, <&kp N>, <&kp MINUS>, <&kp N5>, <&kp N8>, <&kp N7>, <&kp B>, <&kp C>, <&kp F>, <&kp N6>, <&kp MINUS>, <&kp DOT>, <&kp RET>;
};
