#include <behaviors.dtsi>
#include <behaviors/num_word.dtsi> // Requires auto-layer module.
#include <dt-bindings/zmk/keys.h>
#ifdef CONFIG_WIRELESS
  #include <dt-bindings/zmk/bt.h>
  #include <dt-bindings/zmk/outputs.h>
  #define _BT_SEL_KEYS_                                                        \
      &bt BT_SEL 0 &bt BT_SEL 1 &bt BT_SEL 2 &bt BT_SEL 3 &bt BT_CLR
#else
  #define _BT_SEL_KEYS_ &trans &trans &trans &trans &trans
#endif

#include "zmk-helpers/helper.h"
// #include "zmk-helpers/unicode-chars/greek.dtsi"
// #include "zmk-helpers/unicode-chars/german.dtsi"

#define DEF   0
#define NAV   1
// #define MOUSE 2
#define MEDIA 2
#define SYM   3
#define NUM   4
#define FUN   5
#define TAP   6
#define ADJT  7

// #define DEF 0
// #define NAV 1
// #define FN 2
// #define NUM 3
// #define SYS 4
// #define MOUSE 5

#define XXX &none
#define ___ &trans

/* Desktop and tab navigation shortcuts */
#define TAB_RT LC(TAB)
#define TAB_LT LC(LS(TAB))
#define KCOPY   LC(C)
#define KCUT    LC(X)
#define KPASTE  LS(LC(V))
#define KUNDO   LC(Z)

#define QUICK_TAP_MS 175

&sk {
  release-after-ms = <900>;
  quick-release;
};

&sl { // Allow sticky mods to chord across sticky layers.
  ignore-modifiers;
};

&lt {
  flavor = "balanced";
  tapping-term-ms = <200>;
  quick-tap-ms = <QUICK_TAP_MS>;
};

/* Homerow mods */

#define KEYS_L LT0 LT1 LT2 LT3 LT4 LT5 LM0 LM1 LM2 LM3 LM4 LM5 LB0 LB1 LB2 LB3 LB4 LB5  // left hand
#define KEYS_R RT0 RT1 RT2 RT3 RT4 RT5 RM0 RM1 RM2 RM3 RM4 RM5 RB0 RB1 RB2 RB3 RB4 RB5  // right hand

#ifndef LH2
  #define THUMBS LH1 LH0 RH0 RH1         // Thumbs on 34 keys.
#else
  #define THUMBS LH2 LH1 LH0 RH0 RH1 RH2 // Thumbs on 36+ keys.
#endif

#define MAKE_HRM(NAME, HOLD, TAP, TRIGGER_POS)                                 \
  ZMK_HOLD_TAP(NAME, bindings = <HOLD>, <TAP>; flavor = "balanced";            \
               tapping-term-ms = <280>; quick-tap-ms = <QUICK_TAP_MS>;         \
               require-prior-idle-ms = <150>; hold-trigger-on-release;         \
               hold-trigger-key-positions = <TRIGGER_POS>;)

MAKE_HRM(hml, &kp, &kp, KEYS_R THUMBS) // Left-hand HRMs.
MAKE_HRM(hmr, &kp, &kp, KEYS_L THUMBS) // Right-hand HRMs.

// Hack: Make HRM combos tap-only (cf, ZMK issue #544).
#define ZMK_COMBO_8(NAME, TAP, POS, LAYERS, COMBO_MS, IDLE_MS, HOLD, SIDE)     \
  MAKE_HRM(hm_combo_##NAME, &kp, TAP, SIDE THUMBS)                             \
  ZMK_COMBO_6(NAME, &hm_combo_##NAME HOLD 0, POS, LAYERS, COMBO_MS, IDLE_MS)

/* Combos, leader key sequences, mouse emulation */

// #include "combos.dtsi"  // must be sources after HRM-combo hack
// #include "leader.dtsi"
#include "mouse.dtsi"

/* Nav cluster */

// Trigger tap-action on all interrupts.
#define MT_CORE                                                                \
  flavor = "tap-preferred";                                                    \
  tapping-term-ms = <220>;                                                     \
  quick-tap-ms = <220>;                                                        \
  hold-trigger-key-positions = <0>;

&mt { MT_CORE };

ZMK_HOLD_TAP(mt_home, bindings = <&masked_home>, <&kp>; MT_CORE)
ZMK_HOLD_TAP(mt_end, bindings = <&masked_end>, <&kp>; MT_CORE)

#define NAV_LEFT  &mt_home 0   LEFT  // Tap: left  | Long-tap: start of line.
#define NAV_RIGHT &mt_end 0    RIGHT // Tap: right | Long-tap: end   of line.
#define NAV_UP    &mt LC(HOME) UP    // Tap: up    | Long-tap: start of doc.
#define NAV_DOWN  &mt LC(END)  DOWN  // Tap: down  | Long-tap: end   of doc.
#define NAV_BSPC  &mt LG(BSPC) BSPC  // Tap: bspc  | Long-tap: delete word bwd.
#define NAV_DEL   &mt LG(DEL)  DEL   // Tap: del   | Long-tap: delete word fwd.

// Mask CTRL on left/right hold to avoid accidental jumps to start/end of doc.
#define MASK_MODS(NAME, MODS, BINDING)                                         \
  ZMK_MOD_MORPH(NAME, bindings = <BINDING>, <BINDING>; mods = <MODS>;)

MASK_MODS(masked_home, (MOD_LCTL), &kp HOME)
MASK_MODS(masked_end,  (MOD_LCTL), &kp END)

/* Magic-shift & auto-layers */

// Tap: repeat after alpha, else sticky-shift |
// Shift + tap/ double-tap: caps-word | Hold: shift.
#define MAGIC_SHIFT &magic_shift LSHFT 0
ZMK_HOLD_TAP(magic_shift, bindings = <&kp>, <&magic_shift_tap>;
             flavor = "balanced"; tapping-term-ms = <200>;
             quick-tap-ms = <QUICK_TAP_MS>;)
ZMK_MOD_MORPH(magic_shift_tap, bindings = <&shift_repeat>, <&caps_word>;
              mods = <(MOD_LSFT)>;)
ZMK_ADAPTIVE_KEY(
    shift_repeat, bindings = <&sk LSHFT>;
    repeat {
      trigger-keys = <A B C D E F G H I J K L M N O P Q R S T U V W X Y Z>;
      bindings = <&key_repeat>;
      max-prior-idle-ms = <1200>;
      strict-modifiers;
    };)
&caps_word { // Mods deactivate caps-word, requires PR #1451. [TODO: rebase]
  /delete-property/ ignore-modifiers;
};

// Tap: num-word | double-tap: sticky num-layer | Hold: num-layer.
#define SMART_NUM &smart_num NUM 0
ZMK_HOLD_TAP(smart_num, bindings = <&mo>, <&num_dance>; flavor = "balanced";
             tapping-term-ms = <200>; quick-tap-ms = <QUICK_TAP_MS>;)
ZMK_TAP_DANCE(num_dance, bindings = <&num_word NUM>, <&sl NUM>;
              tapping-term-ms = <200>;)

// Smart-mouse, requires tri-state module.
// ZMK_TRI_STATE(
//     smart_mouse, bindings = <&tog MOUSE>, <&none>, <&tog MOUSE>;
//     ignored-key-positions =
//         <LT1 LT2 LH0 LH1 RT1 RT2 RT3 RM0 RM1 RM2 RM3 RM4 RB1 RB2 RB3 RH0 RH1>;
//     ignored-layers = <MEDIA NAV FN>;)

/* Custom behaviors */

// Alt+Tab swapper, requires tri-state module.
ZMK_TRI_STATE(swapper, bindings = <&kt LALT>, <&kp TAB>, <&kt LALT>;
              ignored-key-positions = <LT2 RT2 RM1 RM2 RM3>;)

// Define mod-morph with a *single* mod trigger for less repetition.
#define SIMPLE_MORPH(NAME, MOD, BINDING1, BINDING2)                            \
  ZMK_MOD_MORPH(NAME, mods = <(MOD_L##MOD | MOD_R##MOD)>;                      \
                bindings = <BINDING1>, <BINDING2>;)

// Tap: comma | Shift + tap: semicolon | Ctrl + shift + tap: <.
SIMPLE_MORPH(comma_morph, SFT, &kp COMMA, &comma_inner_morph)
SIMPLE_MORPH(comma_inner_morph, GUI, &kp SEMICOLON, &kp LESS_THAN)

// Tap: dot | Shift + tap: colon | Ctrl + shift + tap: >.
SIMPLE_MORPH(dot_morph, SFT, &kp DOT, &dot_inner_morph)
SIMPLE_MORPH(dot_inner_morph, GUI, &kp COLON, &kp GREATER_THAN)

// Tap: qmark | Shift + tap: excl.
SIMPLE_MORPH(qexcl, SFT, &kp QMARK, &kp EXCL)

// tap: slash | shift + tap: backslash | cmd + tap: question mark
SIMPLE_MORPH(slash_qmark, SFT, &kp FSLH, &slash_inner_qmark)
SIMPLE_MORPH(slash_inner_qmark, GUI, &kp BACKSLASH, &kp QMARK)

// tap: ESC | shift + tap: grave
SIMPLE_MORPH(grave, SFT, &kp ESC, &kp GRAVE)

// tap: media | shift + tap: nav layer
SIMPLE_MORPH(med_nav, SFT, &mo MEDIA, &to NAV)

// Tap: left/right parenthesis | Shift + tap: less-than/greater-than.
SIMPLE_MORPH(lpar_lt, SFT, &kp LPAR, &kp LT)
SIMPLE_MORPH(rpar_gt, SFT, &kp RPAR, &kp GT)

// Tap: space | Shift + tap: dot -> space -> sticky shift | Hold: nav layer.
ZMK_HOLD_TAP(lt_spc, bindings = <&mo>, <&spc_morph>; flavor = "balanced";
             tapping-term-ms = <200>; quick-tap-ms = <QUICK_TAP_MS>;)
SIMPLE_MORPH(spc_morph, SFT, &kp SPACE, &dot_spc)
ZMK_MACRO(dot_spc, bindings = <&kp DOT &kp SPACE &sk LSHFT>; wait-ms = <0>;
          tap-ms = <5>;)

// Tap: backspace | Lshft + tap: delete | Rshft + tap: shift-delete.
ZMK_MOD_MORPH(bs_del, bindings = <&kp BSPC>, <&kp DEL>;
              mods = <(MOD_LSFT|MOD_RSFT)>; keep-mods = <MOD_RSFT>;)

// Tap: copy | double-tap: cut.
ZMK_TAP_DANCE(copy_cut, bindings = <&kp LC(INS)>, <&kp LC(X)>;
              tapping-term-ms = <200>;)

// tap: C | double-tap: copy
ZMK_TAP_DANCE(tdcopy,
    tapping-term-ms = <200>;
    bindings = <&kp C>, <&kp LG(C)>;
)

// tap: V | double-tap: paste
ZMK_TAP_DANCE(tdpaste,
    tapping-term-ms = <200>;
    bindings = <&kp V>, <&kp LG(V)>;
)

// tap: X | double-tap: cut
ZMK_TAP_DANCE(tdcut,
    tapping-term-ms = <200>;
    bindings = <&kp X>, <&kp LG(X)>;
)

// tap: Z | double-tap: undo
ZMK_TAP_DANCE(tdundo,
    tapping-term-ms = <200>;
    bindings = <&kp Z>, <&kp LG(Z)>;
)

// Tap: backspace | Shift + tap: delete | Hold: sym layer.
ZMK_HOLD_TAP(lt_bspc, bindings = <&mo>, <&bspc_morph>; flavor = "balanced";
             tapping-term-ms = <200>; quick-tap-ms = <QUICK_TAP_MS>;)
SIMPLE_MORPH(bspc_morph, SFT, &kp BSPC, &kp DEL)

// Tap: backspace | Lshft + tap: delete | Rshft + tap: shift-delete.
ZMK_MOD_MORPH(bs_del, bindings = <&kp BSPC>, <&kp DEL>;
              mods = <(MOD_LSFT|MOD_RSFT)>; keep-mods = <MOD_RSFT>;)

// Sticky shift + leader.
// ZMK_MACRO(leader_sft, bindings = <&sk LSHFT &leader>;)

// Misc aliases. [TODO: clean up]
#define CANCEL    &kp K_CANCEL            // Cancel caps-word & auto-layers.
#define DSK_PREV  &hmr LCTRL LG(LC(LEFT)) // Previous desktop.
#define DSK_NEXT  &hmr LALT LG(LC(RIGHT)) // Next     desktop.
#define PIN_WIN   &kp LG(LC(LS(Q)))       // Pin window across desktops.
#define PIN_APP   &kp LG(LC(LS(A)))       // Pin application across desktops.
#define DSK_MGR   &kp LA(GRAVE)           // Desktop manager.
#define VOL_DOWN  &hmr RSHFT C_VOL_DN

/* Keymap */

ZMK_CONDITIONAL_LAYER(ADJT, MEDIA FUN, ADJT)  // MEDIA + FUN --> ADJT

#ifndef ZMK_BASE_LAYER
#define ZMK_BASE_LAYER(name, LT, RT, LM, RM, LB, RB, LH, RH)                 \
    ZMK_LAYER(name, LT RT LM RM LB RB LH RH)
#endif

// ZMK_BASE_LAYER(base,
// //╭──────╮ ╭─────────────┬─────────────┬─────────────┬─────────────┬─────────────╮ ╭──────╮ ╭─────────────┬─────────────┬─────────────┬─────────────┬─────────────╮ ╭──────╮
//   &kp ESC    &kp Q         &kp W         &kp E         &kp R         &kp T                &kp Y         &kp U         &kp I         &kp O         &kp P          &bs_del
// //├──────┤ ├─────────────┼─────────────┼─────────────┼─────────────┼─────────────┤ ├──────┤ ├─────────────┼─────────────┼─────────────┼─────────────┼─────────────┤ ├──────┤
//   &mt LC TAB &hml LCMD A   &hml LALT S   &hml LCTRL D  &hml LSHFT F  &kp G                &kp H         &hmr LSHFT J  &hmr RCTRL K  &hmr LALT L   &hmr LCMD SQT  &kp RET
// //├──────┤ ├─────────────┼─────────────┼─────────────┼─────────────┼─────────────┤ ├──────┤ ├─────────────┼─────────────┼─────────────┼─────────────┼─────────────┤ ├──────┤
//   &mt MEDIA  &kp Z         &kp X         &kp C         &kp V         &kp B                &kp N         &kp M         &comma_morph  &dot_morph    &qexcl         &mo FUN
// //├──────┤ ╰─────────────┼─────────────┴─────────────┼─────────────┼─────────────┤ ├──────┤ ├─────────────┼─────────────┼─────────────┴───────────────────────────╯ ├──────┤
//    SMART_NUM                                           &lt_spc NAV 0 &lt MOUSE DEL        &kp RET       &smart_shft   &kp RALT                                    
// //╰──────╯                                           ╰─────────────┴─────────────╯ ╰──────╯ ╰─────────────┴─────────────╯                                           ╰──────╯
// )

// ZMK_BASE_LAYER(nav,
// //╭──────╮ ╭─────────────┬─────────────┬─────────────┬─────────────┬─────────────╮ ╭──────╮ ╭─────────────┬─────────────┬─────────────┬─────────────┬─────────────╮ ╭──────╮
//     X_LT     ___           ___           &kp LS(TAB)   &swapper      ___                  &kp PG_UP     NAV_BSPC      NAV_UP        NAV_DEL       ___             X_RT
// //├──────┤ ├─────────────┼─────────────┼─────────────┼─────────────┼─────────────┤ ├──────┤ ├─────────────┼─────────────┼─────────────┼─────────────┼─────────────┤ ├──────┤
//     X_LM     &sk LGUI      &sk LALT      &sk LSHFT     &sk LCTRL     ___                  &kp PG_DN     NAV_LEFT      NAV_DOWN      NAV_RIGHT     &kp RET         X_RM
// //├──────┤ ├─────────────┼─────────────┼─────────────┼─────────────┼─────────────┤ ├──────┤ ├─────────────┼─────────────┼─────────────┼─────────────┼─────────────┤ ├──────┤
//     X_LB     ___           ___           ___           ___           ___                  &kp INS       &kp TAB       ___           ___           ___             X_RB
// //├──────┤ ╰─────────────┼─────────────┴─────────────┼─────────────┼─────────────┤ ├──────┤ ├─────────────┼─────────────┼─────────────┴───────────────────────────╯ ├──────┤
//     X_LH                                               ___           ___                  ___           CANCEL                                                    X_RH
// //╰──────╯                                           ╰─────────────┴─────────────╯ ╰──────╯ ╰─────────────┴─────────────╯                                           ╰──────╯
// )

// ZMK_BASE_LAYER(media,
// //╭──────╮ ╭─────────────┬─────────────┬─────────────┬─────────────┬─────────────╮ ╭──────╮ ╭─────────────┬─────────────┬─────────────┬─────────────┬─────────────╮ ╭──────╮
//     X_LT     &kp F12       &kp F7        &kp F8        &kp F9        ___                  ___           &kp C_PREV    &kp C_VOL_UP  &kp C_NEXT    ___             X_RT
// //├──────┤ ├─────────────┼─────────────┼─────────────┼─────────────┼─────────────┤ ├──────┤ ├─────────────┼─────────────┼─────────────┼─────────────┼─────────────┤ ├──────┤
//     X_LM     &hml LGUI F11 &hml LALT F4  &hml LSHFT F5 &hml LCTRL F6 ___                  ___           DSK_PREV      VOL_DOWN      DSK_NEXT      ___             X_RM
// //├──────┤ ├─────────────┼─────────────┼─────────────┼─────────────┼─────────────┤ ├──────┤ ├─────────────┼─────────────┼─────────────┼─────────────┼─────────────┤ ├──────┤
//     X_LB     &kp F10       &kp F1        &kp F2        &kp F3        ___                  PIN_APP       PIN_WIN       DSK_MGR       ___           ___             X_RB
// //├──────┤ ╰─────────────┼─────────────┴─────────────┼─────────────┼─────────────┤ ├──────┤ ├─────────────┼─────────────┼─────────────┴───────────────────────────╯ ├──────┤
//     X_LH                                               ___           ___                  &kp C_MUTE    &kp C_PP                                                  X_RH
// //╰──────╯                                           ╰─────────────┴─────────────╯ ╰──────╯ ╰─────────────┴─────────────╯                                           ╰──────╯
// )

// ZMK_BASE_LAYER(num,
// //╭──────╮ ╭─────────────┬─────────────┬─────────────┬─────────────┬─────────────╮ ╭──────╮ ╭─────────────┬─────────────┬─────────────┬─────────────┬─────────────╮ ╭──────╮
//     X_LT     ___           &kp N7        &kp N8        &kp N9        ___                  ___           ___           ___           ___           ___             X_RT
// //├──────┤ ├─────────────┼─────────────┼─────────────┼─────────────┼─────────────┤ ├──────┤ ├─────────────┼─────────────┼─────────────┼─────────────┼─────────────┤ ├──────┤
//     X_LM     &hml LGUI N0  &hml LALT N4  &hml LSHFT N5 &hml LCTRL N6 ___                  ___           ___           ___           ___           ___             X_RM
// //├──────┤ ├─────────────┼─────────────┼─────────────┼─────────────┼─────────────┤ ├──────┤ ├─────────────┼─────────────┼─────────────┼─────────────┼─────────────┤ ├──────┤
//     X_LB     ___           &kp N1        &kp N2        &kp N3        ___                  ___           ___           ___           ___           ___             X_RB
// //├──────┤ ╰─────────────┼─────────────┴─────────────┼─────────────┼─────────────┤ ├──────┤ ├─────────────┼─────────────┼─────────────┴───────────────────────────╯ ├──────┤
//     X_LH                                               ___           ___                  ___           ___                                                       X_RH
// //╰──────╯                                           ╰─────────────┴─────────────╯ ╰──────╯ ╰─────────────┴─────────────╯                                           ╰──────╯
// )

// ZMK_BASE_LAYER(fun,
// //╭──────╮ ╭─────────────┬─────────────┬─────────────┬─────────────┬─────────────╮ ╭──────╮ ╭─────────────┬─────────────┬─────────────┬─────────────┬─────────────╮ ╭──────╮
//     X_LT     ___           &kp N7        &kp N8        &kp N9        ___                  ___           ___           ___           ___           ___             X_RT
// //├──────┤ ├─────────────┼─────────────┼─────────────┼─────────────┼─────────────┤ ├──────┤ ├─────────────┼─────────────┼─────────────┼─────────────┼─────────────┤ ├──────┤
//     X_LM     &hml LGUI N0  &hml LALT N4  &hml LSHFT N5 &hml LCTRL N6 ___                  ___           ___           ___           ___           ___             X_RM
// //├──────┤ ├─────────────┼─────────────┼─────────────┼─────────────┼─────────────┤ ├──────┤ ├─────────────┼─────────────┼─────────────┼─────────────┼─────────────┤ ├──────┤
//     X_LB     ___           &kp N1        &kp N2        &kp N3        ___                  ___           ___           ___           ___           ___             X_RB
// //├──────┤ ╰─────────────┼─────────────┴─────────────┼─────────────┼─────────────┤ ├──────┤ ├─────────────┼─────────────┼─────────────┴───────────────────────────╯ ├──────┤
//     X_LH                                               ___           ___                  ___           ___                                                       X_RH
// //╰──────╯                                           ╰─────────────┴─────────────╯ ╰──────╯ ╰─────────────┴─────────────╯                                           ╰──────╯
// )



// // ZMK_BASE_LAYER(sys,
// // //╭──────╮ ╭─────────────┬─────────────┬─────────────┬─────────────┬─────────────╮ ╭──────╮ ╭─────────────┬─────────────┬─────────────┬─────────────┬─────────────╮ ╭──────╮
// //     X_LT                                _BT_SEL_KEYS_                                X_MT     ___           ___           ___           ___           ___             X_RT
// // //├──────┤ ├─────────────┼─────────────┼─────────────┼─────────────┼─────────────┤ ├──────┤ ├─────────────┼─────────────┼─────────────┼─────────────┼─────────────┤ ├──────┤
// //     X_LM     ___           ___           ___           ___           &bootloader     X_MM     &bootloader   ___           ___           ___           ___             X_RM
// // //├──────┤ ├─────────────┼─────────────┼─────────────┼─────────────┼─────────────┤ ├──────┤ ├─────────────┼─────────────┼─────────────┼─────────────┼─────────────┤ ├──────┤
// //     X_LB     ___           ___           ___           ___           &sys_reset      X_MB     &sys_reset    ___           ___           ___           ___             X_RB
// // //├──────┤ ╰─────────────┼─────────────┴─────────────┼─────────────┼─────────────┤ ├──────┤ ├─────────────┼─────────────┼─────────────┴───────────────────────────╯ ├──────┤
// //     X_LH                                               ___           ___             X_MH     ___           ___                                                       X_RH
// // //╰──────╯                                           ╰─────────────┴─────────────╯ ╰──────╯ ╰─────────────┴─────────────╯                                           ╰──────╯
// // )

// ZMK_BASE_LAYER(mouse,
// //╭──────╮ ╭─────────────┬─────────────┬─────────────┬─────────────┬─────────────╮ ╭──────╮ ╭─────────────┬─────────────┬─────────────┬─────────────┬─────────────╮ ╭──────╮
//     X_LT     ___           ___           ___           ___           ___                  ___           &kp PG_UP     U_MS_U         &kp PG_DN    ___             X_RT
// //├──────┤ ├─────────────┼─────────────┼─────────────┼─────────────┼─────────────┤ ├──────┤ ├─────────────┼─────────────┼─────────────┼─────────────┼─────────────┤ ├──────┤
//     X_LM     ___           ___           ___           ___           ___                  U_WH_L        U_MS_L        U_MS_D         U_MS_R       U_WH_R          X_RM
// //├──────┤ ├─────────────┼─────────────┼─────────────┼─────────────┼─────────────┤ ├──────┤ ├─────────────┼─────────────┼─────────────┼─────────────┼─────────────┤ ├──────┤
//     X_LB     ___           ___           ___           ___           ___                  ___           &mkp LCLK     &mkp MCLK      &mkp RCLK    ___             X_RB
// //├──────┤ ╰─────────────┼─────────────┴─────────────┼─────────────┼─────────────┤ ├──────┤ ├─────────────┼─────────────┼─────────────┴───────────────────────────╯ ├──────┤
//     X_LH                                               ___           ___                  U_WH_U        U_WH_D                                                    X_RH
// //╰──────╯                                           ╰─────────────┴─────────────╯ ╰──────╯ ╰─────────────┴─────────────╯                                           ╰──────╯
// )

// ZMK_BASE_LAYER(tap,
// //╭──────╮ ╭─────────────┬─────────────┬─────────────┬─────────────┬─────────────╮ ╭──────╮ ╭─────────────┬─────────────┬─────────────┬─────────────┬─────────────╮ ╭──────╮
//     X_LT     ___           ___           ___           ___           ___                  ___           &kp PG_UP     U_MS_U         &kp PG_DN    ___             X_RT
// //├──────┤ ├─────────────┼─────────────┼─────────────┼─────────────┼─────────────┤ ├──────┤ ├─────────────┼─────────────┼─────────────┼─────────────┼─────────────┤ ├──────┤
//     X_LM     ___           ___           ___           ___           ___                  U_WH_L        U_MS_L        U_MS_D         U_MS_R       U_WH_R          X_RM
// //├──────┤ ├─────────────┼─────────────┼─────────────┼─────────────┼─────────────┤ ├──────┤ ├─────────────┼─────────────┼─────────────┼─────────────┼─────────────┤ ├──────┤
//     X_LB     ___           ___           ___           ___           ___                  ___           &mkp LCLK     &mkp MCLK      &mkp RCLK    ___             X_RB
// //├──────┤ ╰─────────────┼─────────────┴─────────────┼─────────────┼─────────────┤ ├──────┤ ├─────────────┼─────────────┼─────────────┴───────────────────────────╯ ├──────┤
//     X_LH                                               ___           ___                  U_WH_U        U_WH_D                                                    X_RH
// //╰──────╯                                           ╰─────────────┴─────────────╯ ╰──────╯ ╰─────────────┴─────────────╯                                           ╰──────╯
// )

// ZMK_BASE_LAYER(adjt,
// //╭──────╮ ╭─────────────┬─────────────┬─────────────┬─────────────┬─────────────╮ ╭──────╮ ╭─────────────┬─────────────┬─────────────┬─────────────┬─────────────╮ ╭──────╮
//     X_LT     ___           ___           ___           ___           ___                  ___           &kp PG_UP     U_MS_U         &kp PG_DN    ___             X_RT
// //├──────┤ ├─────────────┼─────────────┼─────────────┼─────────────┼─────────────┤ ├──────┤ ├─────────────┼─────────────┼─────────────┼─────────────┼─────────────┤ ├──────┤
//     X_LM     ___           ___           ___           ___           ___                  U_WH_L        U_MS_L        U_MS_D         U_MS_R       U_WH_R          X_RM
// //├──────┤ ├─────────────┼─────────────┼─────────────┼─────────────┼─────────────┤ ├──────┤ ├─────────────┼─────────────┼─────────────┼─────────────┼─────────────┤ ├──────┤
//     X_LB     ___           ___           ___           ___           ___                  ___           &mkp LCLK     &mkp MCLK      &mkp RCLK    ___             X_RB
// //├──────┤ ╰─────────────┼─────────────┴─────────────┼─────────────┼─────────────┤ ├──────┤ ├─────────────┼─────────────┼─────────────┴───────────────────────────╯ ├──────┤
//     X_LH                                               ___           ___                  U_WH_U        U_WH_D                                                    X_RH
// //╰──────╯                                           ╰─────────────┴─────────────╯ ╰──────╯ ╰─────────────┴─────────────╯                                           ╰──────╯
// )

ZMK_BASE_LAYER(Base,
  &kp TAB  &kp Q &kp W &kp E     &kp R    &kp T,                          &kp Y     &kp U    &kp I     &kp O   &kp P    &bs_del,
  &grave &hml LCTRL A   &hml LALT S   &hml LGUI D  &hml LSHFT F  &kp G,   &kp H &hmr RSHFT J  &hmr LGUI K  &hmr LALT L   &hmr LCTRL SQT  &kp ENTER,
    &med_nav &tdundo &tdcut &tdcopy    &tdpaste    &kp B,                          &kp N     &kp M    &comma_morph  &dot_morph &slash_qmark &mo FUN,
                            SMART_NUM &lt_spc NAV 0  &lt_bspc SYM 0,       &kp ENTER MAGIC_SHIFT  &kp RALT
)

ZMK_BASE_LAYER(Navigation,
  &kp LG(Q)    &kp TAB_LT    &kp TAB_RT           &kp LS(TAB)   &swapper      &kp LC(F4),      &kp C_AC_BACK     &kp HOME    NAV_UP     &kp PG_UP &kp C_AC_FORWARD NAV_BSPC,
  &trans  &sk LCTRL     &sk LALT      &sk LGUI      &sk LSHFT    &trans,                          &caps_word     NAV_LEFT    NAV_DOWN     NAV_RIGHT   NAV_DEL  &trans,
             &to DEF   &kp KUNDO &kp KCUT &kp KCOPY &kp KPASTE    &trans,                    &kp K_APP     &kp END    &kp INS &kp PG_DN &kp C_AC_CUT &trans,
                             &trans &trans &trans,    &trans &trans   &trans
)
// ZMK_BASE_LAYER(Mouse,
// &trans  &trans &trans &trans &trans &trans                          &trans U_WH_L U_MS_U U_WH_R &trans    &trans
//   &trans  &sk LGUI  &sk LALT  &sk LCTRL  &sk LSHFT  &trans          &trans U_MS_L U_MS_D U_MS_R  &trans &trans
//         &trans &trans &trans &trans &trans &trans                    &trans U_WH_D U_WH_U &trans &trans &trans
//                              &trans &trans &trans    U_BTN3 U_BTN1 U_BTN2
// )

ZMK_BASE_LAYER(Media,
&trans  &trans &trans &trans     &trans    &trans,                          U_WH_U  &trans &trans &trans     &trans    &trans,
  &trans  &sk LCTRL      &sk LALT      &sk LGUI     &sk LSHFT    &trans,    U_WH_D  &kp C_PREV &kp C_VOL_UP &kp C_VOL_DN    &kp C_NEXT    &trans,
        &trans &trans &trans &trans &trans &trans,                          &trans &trans &trans     &trans    &trans &trans,
                             &trans &trans &trans,    &kp C_STOP   &kp C_PP   &kp C_MUTE
)

ZMK_BASE_LAYER(Symbols,
 &trans  &trans &trans &trans     &trans    &trans,                         &kp LBKT &kp AMPS &kp STAR     &kp LPAR    &kp RBKT &trans,
&trans   &sk LCTRL      &sk LALT      &sk LGUI     &sk LSHFT  &trans,       &kp SEMI &kp DLLR &kp PRCNT    &kp CARET    &kp PLUS &trans,
 &trans  &trans &trans &trans     &trans    &trans,                         &kp TILDE &kp EXCL &kp AT     &kp HASH    &kp BSLH &trans,
                             &trans  &trans &trans,                        &kp LPAR &kp RPAR &kp UNDER
)

ZMK_BASE_LAYER(Numbers,
&trans  &trans &trans &trans     &trans    &trans,                          &kp LBKT  &kp N7 &kp N8 &kp N9 &kp KP_MULTIPLY &trans,
  &trans  &sk LCTRL      &sk LALT      &sk LGUI     &sk LSHFT    &trans,    &kp SEMI  &kp N4 &kp N5 &kp N6 &kp EQUAL    &trans,
             &trans  &trans &trans &trans     &trans    &trans,             &kp GRAVE &kp N1 &kp N2 &kp N3 &kp KP_DOT &trans,
                            &trans &trans &trans,    &kp MINUS   &kp KP_PLUS   &kp N0
)

ZMK_BASE_LAYER(Function,
&trans  &kp F12 &kp F7 &kp F8     &kp F9    &kp PSCRN,                          &trans  &trans &trans &trans     &trans    &trans,
  &trans  &kp F11 &kp F4 &kp F5     &kp F6    &kp SLCK,                          &trans  &sk RSHFT  &sk LGUI &sk LALT &sk LCTRL    &trans,
              &trans &kp F10 &kp F1 &kp F2     &kp F3    &kp PAUSE_BREAK,                    &trans &trans &trans     &trans    &trans &trans,
                             &trans &trans &trans,    &trans &trans   &trans
)

ZMK_BASE_LAYER(Tap-only,
&kp ESC &kp Q &kp W &kp E     &kp R    &kp T,                         &kp Y     &kp U    &kp I     &kp O   &kp P    &kp BSPC,
  &kp TAB &kp A &kp S &kp D     &kp F    &kp G,                          &kp H     &kp J    &kp K     &kp L   &kp SQT  &to DEF,
             &mo NAV  &kp Z &kp X &kp C     &kp V    &kp B,                          &kp N     &kp M    &kp COMMA  &kp DOT &kp SLASH &mo NAV,
                              &kp LCTRL &kp SPC  &kp BSPC,     &kp ENTER &kp RSHFT  &kp RCTRL
)

ZMK_BASE_LAYER(Adjust,
&out OUT_TOG &bt BT_SEL 0 &bt BT_SEL 1 &bt BT_SEL 2 &bt BT_SEL 3 &bt BT_SEL 4, &bt BT_NXT &bt BT_PRV &trans &trans &trans &trans,
  &to TAP &trans     &trans     &trans       &trans &trans,                  &trans &trans &trans &trans &trans &to DEF,
          &trans     &trans     &trans       &trans &trans &trans,            &bt BT_CLR &trans &trans &trans &trans &trans,
                           &trans    &trans &trans,                          &trans &trans &trans
)

/* vim: set ft=c tw=146: */
